## meta-backport/conf/layer.conf
```bitbake
# We have a conf and classes directory, add to BBPATH
BBPATH .= ":${LAYERDIR}"

# We have recipes-* directories, add to BBFILES
BBFILES += "${LAYERDIR}/recipes-*/*/*.bb \
            ${LAYERDIR}/recipes-*/*/*.bbappend"

BBFILE_COLLECTIONS += "backport"
BBFILE_PATTERN_backport = "^${LAYERDIR}/"
BBFILE_PRIORITY_backport = "13"

LAYERDEPENDS_backport = "core"
LAYERSERIES_COMPAT_backport = "dunfell"
```

## meta-backport/conf/machine/jetson-agx-xavier-devkit-cuda.conf
```bitbake
#@TYPE: Machine
#@NAME: Nvidia Jetson Xavier Cuda GCC
#@DESCRIPTION: Nvidia Jetson Xavier dev board with Cuda GCC

require conf/machine/jetson-agx-xavier-devkit.conf

# Inspired by meta-tegra master commit 4a89e2bdcc8052bbf7b7dff4b5caeb8aa1903995
# We can't change the tegra-common.inc in meta-tegra so append to the machine
# instead

TEGRA_CUDA_ARCHITECTURE ?= "72"
CUDA_ARCHITECTURES ?= "${TEGRA_CUDA_ARCHITECTURE}"

# See https://github.com/OE4T/meta-tegra/wiki/Creating-a-custom-MACHINE
MACHINEOVERRIDES = "cuda:tegra:tegra194:jetson-agx-xavier-devkit:${MACHINE}"
PACKAGE_EXTRA_ARCHS_append = " jetson-agx-xavier-devkit"
```

## meta-lauterbach/conf/machine/agx-xavier-lauterbach.conf
```bitbake
#@TYPE: Machine
#@NAME: Nvidia Jetson Xavier Lauterbach
#@DESCRIPTION: Nvidia Jetson Xavier dev board with changes for Lauterbach

# Used to show TRACE32 with Lauterbach debugger on the agx xavier development kit.

require conf/machine/jetson-agx-xavier-devkit.conf

# See https://github.com/OE4T/meta-tegra/wiki/Creating-a-custom-MACHINE
MACHINEOVERRIDES = "cuda:tegra:tegra194:jetson-agx-xavier-devkit:${MACHINE}"
PACKAGE_EXTRA_ARCHS:append = " jetson-agx-xavier-devkit"
```
